#include <NeoICSerial.h>
#include <avr/io.h>
#include <avr/pgmspace.h>
#include <avr/interrupt.h>
#include <avr/sleep.h>

//----------------- VideoBlaster definitions -----------------

#define DOTCLK 0 // Pixel clock (0 for 8MHz, 1 for 4MHz)
#define SYNCPIN 0b10000000 // NOTE edp: orig was "4"  // Pin in PORTD that that is connected for sync
#define CHARS_PER_ROW 39
#define ROWS_PER_COL 25

#define SEND_BLANK_CHARACTER UDR0 = 0; while ((UCSR0A & _BV (UDRE0)) == 0) {}

volatile byte VBE = 0;   // Video blanking status. If this is not zero you should sleep to keep the video smooth

//#define WAIT_VBE while (VBE==1) sleep_cpu();
#define WAIT_VBE while (VBE==1) {}

// These should not be used outside the ISR
unsigned int scanline = 0;
unsigned int videoptr = 0;
byte row;

// This is the video character ROM (8x8 font definition)
const unsigned char charROM [8] [128] PROGMEM = { 0x1C , 0x18 , 0x7C , 0x1C , 0x78 , 0x7E , 0x7E , 0x1C , 0x42 , 0x1C , 0xE ,
                                                  0x42 , 0x40 , 0x42 , 0x42 , 0x18 , 0x7C , 0x18 , 0x7C , 0x3C , 0x3E , 0x42 , 0x42 , 0x42 , 0x42 , 0x22 , 0x7E , 0x42 , 0x42 ,
                                                  0x18 , 0x0 , 0x0 , 0x0 , 0x8 , 0x24 , 0x24 , 0x8 , 0x0 , 0x30 , 0x4 , 0x4 , 0x20 , 0x8 , 0x0 , 0x0 , 0x0 , 0x0 , 0x0 , 0x3C ,
                                                  0x8 , 0x3C , 0x3C , 0x4 , 0x7E , 0x1C , 0x7E , 0x3C , 0x3C , 0x0 , 0x0 , 0xE , 0x0 , 0x70 , 0x3C , 0x0 , 0x8 , 0x10 , 0x0 ,
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                                                  0xC0 , 0xE0 , 0x7 , 0x0 , 0x0 , 0xFF , 0xFF , 0xF0 , 0x0 , 0x0 , 0x0 , 0xF
                                                };

const byte MSPIM_SCK = 4;  // This is needed for the hardware to work
const byte MSPIM_SS = 5;   // This is needed for the hardware to work

//--------------------------------------------------------------

// orig 22 cols, 24 rows
#define MAX_VID_RAM (CHARS_PER_ROW*ROWS_PER_COL)
char videomem[MAX_VID_RAM];

// hold what we're currently considering sync on or off, depending on sync inversion
byte syncON, syncOFF;

ISR(TIMER0_COMPA_vect) {   // Video interrupt. This is called at every line in the frame.
  // start sync pulse
  PORTD = syncON;

  // update scanline number
  scanline++;

  // begin inverted (Vertical) sync after line 247
  if (scanline == 248) {
    syncON = 0b10000000;
    syncOFF = 0;
  } else if (scanline == 251) { // back to regular sync after line 250
    syncON = 0;
    syncOFF = 0b10000000;
  } else if (scanline == 263) { // start new frame after line 262
    scanline = 1;
    VBE = 0;
  }

  //adjust to make 5 us pulses
  _delay_us(3);

  //end sync pulse
  PORTD = syncOFF;

  if (scanline == 19 ) {
    videoptr = 0;
    row = 0;
  }

  // scanlines 40 to 231 are image lines
  if ((scanline >= 20) && (scanline < (20 + 8 * ROWS_PER_COL))) {

    const register byte * linePtr = &charROM [ row & 0x07 ] [0];
    register byte * messagePtr = (byte *) & videomem [videoptr] ;

    UCSR0B = _BV(TXEN0);

    // center image on screen
    SEND_BLANK_CHARACTER
    SEND_BLANK_CHARACTER
    SEND_BLANK_CHARACTER
#if DOTCLK == 0
    SEND_BLANK_CHARACTER
#endif

    // send a line of data
    byte chars_per_row = CHARS_PER_ROW;
    while (chars_per_row --) {

      while ((UCSR0A & _BV (UDRE0)) == 0)
      {}
      UDR0 = ~(pgm_read_byte (linePtr + (* messagePtr++)));
    }
    while ((UCSR0A & _BV (UDRE0)) == 0)
    {}
    UCSR0B = 0;

    // update videoptr to the start of the next line of characters
    row++;
    videoptr = (row >> 3) * CHARS_PER_ROW;

    // signal that we're drawing the image, not in vertical blank
    VBE = 1;
  }
}

void fillVideoMemory() {
  for (int i = 0; i < MAX_VID_RAM; i++) {
    //    videomem[i] = 126; // graphical character of half height square
    //    videomem[i] = (i&1?0xF0:0x0F); // alternate two specific characters
    //    videomem[i] = 48 + (i % 10); // count through the digits
    //    videomem[i] = i%128; // cycle through every character
    //    videomem[i] = 31; // fill with a single character. 31 is a left horizontal arrow
    //    videomem[i] = (i%26); // the first 26 characters are A-Z (nonascii)
    videomem[i] = 32; // fill with blanks, 32 = ' ' in this charset
  }
}

NeoICSerial softSerial; // for '328, RX=8, TX=9
void setupCommunication() {
  pinMode(8, INPUT);
  pinMode(9, OUTPUT);
  softSerial.begin(9600);
}

int videoCursor = 0;
void advanceCursor(int amount) {
  // TODO if amount would go past the end of the VID_RAM
  //      scroll everything instead of wrapping to top of
  //      the screen
  videoCursor = (videoCursor + amount) % MAX_VID_RAM;
}

void writeByte(byte inp) {
  videomem[videoCursor] = inp & 0x7F;
  advanceCursor(1);
}

void setupHorizSyncISR() {
  cli();
  TCCR0A = 0;
  TCCR0B = 0;
  TCNT0  = 0;
  // "In analog television systems the horizontal frequency is between 15.625 kHz and 15.750 kHz."
  // "...each line takes 63.5us to paint (15.75kHz)"
  // OCR0A = 127; // 15.625 khz
  OCR0A = 126; // 15.748 khz
  // OCR0A = 125; // 15.873 khz
  TCCR0A |= (1 << WGM01);
  TCCR0B |= (0 << CS02) | (1 << CS01) | (0 << CS00);
  TIMSK0 |= (1 << OCIE0A);
  set_sleep_mode (SLEEP_MODE_IDLE);
  sei();
}

void setup () {
  pinMode (MSPIM_SS, OUTPUT);
  pinMode(7, OUTPUT); // video sync output
  UBRR0 = 0;
  UCSR0A = _BV (TXC0);
  pinMode (MSPIM_SCK, OUTPUT);
  UCSR0C = _BV (UMSEL00) | _BV (UMSEL01);
  UCSR0B = _BV (TXEN0);
  UBRR0 = DOTCLK;

  // the built-in LED
  pinMode(13, OUTPUT);
  digitalWrite(13, LOW);

  // TXD aka D1 (Arduino) aka PD1 (Atmel)
  pinMode(1, OUTPUT);   //A must for MSMSPI VIDEO to work
  digitalWrite(1, LOW); //A must for MSMSPI VIDEO to work

  fillVideoMemory();

  setupCommunication();

  setupHorizSyncISR();
}

unsigned int bytesReceived = 0;
void loop () {
  WAIT_VBE
  // do stuff here during the VBlank

  if (softSerial.available() > 0) {
    TIMSK0 &= ~(1 << OCIE0A);  // stop horiz sync interrupt
    int inp = 0;
    while (softSerial.available() > 0) {
      inp = softSerial.read();

      // map ASCII input to our weird character set
      //   and deal with (a few) control codes
      if (inp >= 32 && inp < 64) {
        // these actually look like the map directly
        writeByte(inp);
      } else if ( inp >= 64 && inp < 96) {
        // these map to 0 ... something
        writeByte(inp - 64);
      } else if ( inp >= 96 && inp < 128 ) {
        // lower case isn't in our font so smash it to upper for now :(
        writeByte(inp - 96);
      } else if ( inp == '\n') {
        advanceCursor(CHARS_PER_ROW); // move down a row
        videoCursor -= (videoCursor % CHARS_PER_ROW); // move back to start of row
      } else if ( inp == 0x0C) { // 'new page' or 'form feed'
        fillVideoMemory();
        videoCursor = 0;
      }
      bytesReceived += 1;
    }
    TIMSK0 |= (1 << OCIE0A); // restart horiz sync interrupt
  }
}
